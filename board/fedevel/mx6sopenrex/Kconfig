## board/fedevel/mx6sopenrex/Kconfig
```kconfig
if TARGET_MX6SOPENREX

config SYS_BOARD
	default "mx6sopenrex"

config SYS_VENDOR
	default "fedevel"

config SYS_CONFIG_NAME
	default "mx6sopenrex"

endif
```
